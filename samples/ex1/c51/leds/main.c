/*C**************************************************************************
* NAME: test_api.c 
*----------------------------------------------------------------------------
* CREATED_BY:    Jean-Sebastien BERTHY
* CREATION_DATE: 15/01/2001 
* AUTHOR:        $Author: jberthy $
* REVISION       $Revision: 1.3 $
* DATE:          $Date: 2001/09/06 06:23:19 $
*----------------------------------------------------------------------------
* PURPOSE: 
*
*****************************************************************************/

/*_____ I N C L U D E S ____________________________________________________*/
#include <reg52.h>
#include "stdio.h"
#include "compiler.h"
//#include "config.h"

/*_____ M A C R O S ________________________________________________________*/

/*_____ D E F I N I T I O N ________________________________________________*/

/*_____ D E C L A R A T I O N ______________________________________________*/


/*F**************************************************************************
* NAME: uart_init 
*----------------------------------------------------------------------------
* AUTHOR: Jean-Sebatien BERTHY 
*****************************************************************************/
void uart_init (void)
{
  SCON = 0x50;
  TMOD = TMOD | 0x20 ;      /*  Timer1 in mode 2 & not gated */
//  TH1 = 0xF3;               /*  4800 bauds at 12 MHZ */
//  TL1 = 0xF3; 

	TH1 = 0xf6;               /*  4800 bauds at 18.432 MHZ */
	TL1 = 0x00; 
	
  PCON = PCON & 0X80;
  TCON |= 0x40;
  TI=1;
}

/*F**************************************************************************
* NAME: bin_to_asc.        
* PARAMS:  
* to_convert: byte to parse in ascii
*----------------------------------------------------------------------------
* PURPOSE: This function return the ascii value
*****************************************************************************/
Uchar bin_to_ascii (Uchar to_convert)
{
  Uchar convert;

  if ((to_convert >= 0) &&
      (to_convert <= 9)   )
  {
    convert = to_convert + 0x30;
  }
  else
  {
    convert = to_convert + 0x37;
  }
  return (convert);
}

/*F**************************************************************************
* NAME: tx_data 
*----------------------------------------------------------------------------
* PARAMS:  
* data_to_tx: byte to transmit on the line
*----------------------------------------------------------------------------
* PURPOSE: This function send on UART the value
*****************************************************************************/
void tx_data (Uchar data_to_tx)
{
  while(!TI);
  TI = 0;
  SBUF = data_to_tx;
}

/*F**************************************************************************
* NAME: send_byte_ascii 
*----------------------------------------------------------------------------
* PARAMS:  
* byte_to_tx: byte to send on UART in ascii
*----------------------------------------------------------------------------
* PURPOSE: 
*****************************************************************************/
void send_byte_ascii(Uchar byte_to_tx)
{
  Uchar data_to_tx;

  data_to_tx = bin_to_ascii( byte_to_tx >> 4);
  tx_data(data_to_tx);
  data_to_tx = bin_to_ascii( byte_to_tx & 0x0F);
  tx_data(data_to_tx);
}

/*F**************************************************************************
* NAME: send_cr_lf 
*----------------------------------------------------------------------------
* PARAMS:  
*----------------------------------------------------------------------------
* PURPOSE: 
*****************************************************************************/
void send_cr_lf(void)
{
  tx_data(0x0D);
  tx_data(0x0A);
}

/*F**************************************************************************
* NAME: send_cr_lf 
*----------------------------------------------------------------------------
* PARAMS:  
*----------------------------------------------------------------------------
* PURPOSE: 
*****************************************************************************/
sbit led1 =P1^3 ;
sbit led2 =P1^4 ;
		
void led_on(Uchar index)
{
	if(1==index)
	{
		led1 = 0;
		led2 = 0;
	}
	else if(2==index)
	{
		led1 = 1;
		led2 = 1;
	}
	else
		;
}

/*F**************************************************************************
* NAME: main 
*----------------------------------------------------------------------------
* AUTHOR: Jean-Sebatien BERTHY 
*****************************************************************************/
void main (void)
{
  Uchar	value=0;
  
	uart_init();

	printf("-----------------Bootloader----------------------\n");
	printf("1.leds on\n");
	printf("2.leds off\n");
	printf("press 'q' for quit\n");
	printf("--------------------end--------------------------\n");
	while(1)
	{
		value = getchar();
		printf("\n");
		switch(value)
		{
			case '1':
				led_on(1);
				printf("1.leds on\n");
				break;
			case '2':
				led_on(2);
				printf("2.leds off\n");
				break;
			
			default:
				printf("not support\n");
				break;
		}
	}
}























